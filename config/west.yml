## config/west.yml
```yaml
manifest:
  remotes:
    - name: zmkfirmware
      url-base: https://github.com/dnaq
  projects:
    - name: zmk
      remote: zmkfirmware
      revision: plover-hid-hog-attempt
      import: app/west.yml
  self:
    path: config
```
